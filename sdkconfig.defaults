## sdkconfig.defaults
```kconfig
CONFIG_IDF_TARGET="esp32s3"
CONFIG_IDF_TARGET_ESP32S3=y
CONFIG_ESPTOOLPY_FLASHSIZE_16MB=y
CONFIG_PARTITION_TABLE_CUSTOM=y
CONFIG_PARTITION_TABLE_CUSTOM_FILENAME="partitions.csv"
CONFIG_PARTITION_TABLE_FILENAME="partitions.csv"

# Enable PSRAM (essential for ESP-SR)
CONFIG_ESP32S3_SPIRAM_SUPPORT=y
CONFIG_SPIRAM_SUPPORT=y
CONFIG_SPIRAM_MODE_OCT=y
CONFIG_SPIRAM_SPEED_80M=y

# Speech Recognition Configuration
CONFIG_MODEL_IN_FLASH=y
CONFIG_USE_WAKENET=y
CONFIG_SR_WN_WN9_JARVIS_TTS=y
CONFIG_USE_MULTINET=y
CONFIG_SR_MN_ENGLISH=y
CONFIG_SR_MN_CN_NONE=y
CONFIG_SR_MN_EN_MULTINET7_QUANT=y
```
